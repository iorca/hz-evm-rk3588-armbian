// SPDX-License-Identifier: (GPL-2.0+ OR MIT)
//
// 快速验证用 overlay：给 LCD_RESX 加一次「先拉低、再释放」的复位脉冲。
//
// 背景：驱动里 enable-gpios 那条路径只做 "assert 后保持"，从不释放 ——
//   发 MIPI 初始化指令之前屏根本没被复位过。DSI 命令照样发出去（不报错，
//   connector 也 enabled），但 0x9F 解锁吃不进去 → 背光亮、无画面。
//
// 为什么只加不删：
//   驱动 prepare() 的顺序是
//       drive_gpio(enable, pulse=false)   -> 拉到 asserted 电平并保持
//       drive_gpio(reset,  pulse=true)    -> assert 120ms -> release 120ms
//       tl060fvxs07_init_sequence()       -> 才发指令
//   当前 dtb 里 enable-gpios 是 GPIO_ACTIVE_HIGH（asserted = 高），
//   这里再补一条低有效的 reset-gpios（asserted = 低），合成出来的物理波形就是
//       高 120ms -> 低 120ms -> 高 120ms -> 发初始化指令
//   —— 正好是一次标准的复位脉冲。所以**不需要 /delete-property/**，
//   也不需要 #include（数值写死，避免板端 cpp 找不到头文件的麻烦）。
//
//   <&gpio0 10 1>  =  gpio0, line 10 (= GPIO0_B2, RK_PB2 = 8+2), flags 1 (= GPIO_ACTIVE_LOW)
//
// 用法（板子上）：
//   dtc -@ -I dts -O dtb -o tianma-resetfix.dtbo tianma-resetfix.dts
//   cp tianma-resetfix.dtbo /boot/overlay-user/
//   echo "user_overlays=tianma-resetfix" >> /boot/armbianEnv.txt
//   reboot
//
// （若 dtc 仍报 syntax error，多半是文件被转成了 CRLF：
//    sed -i 's/\r$//' tianma-resetfix.dts  然后再编）

/dts-v1/;
/plugin/;

&tianma_panel {
	reset-gpios = <&gpio0 10 1>;
};
